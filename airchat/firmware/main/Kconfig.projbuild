## iceclock/firmware/main/Kconfig.projbuild
```kconfig
menu "IceClock Configuration"

    menu "Network and time"
        config ICECLOCK_WIFI_SSID
            string "WiFi SSID (leave empty for offline mode)"
            default ""

        config ICECLOCK_WIFI_PASSWORD
            string "WiFi password"
            default ""

        config ICECLOCK_NTP_SERVER
            string "NTP server"
            default "pool.ntp.org"

        config ICECLOCK_TIMEZONE
            string "POSIX timezone"
            default "CST-8"
            help
                POSIX TZ string. CST-8 is UTC+8 without daylight saving.

        config ICECLOCK_WIFI_CONNECT_TIMEOUT_SEC
            int "Initial WiFi wait time (seconds)"
            range 1 60
            default 12
    endmenu

    menu "HUB75 panel"
        config ICECLOCK_PANEL_WIDTH
            int "Panel width"
            range 32 128
            default 64

        choice ICECLOCK_PANEL_HEIGHT
            prompt "Panel height / scan ratio"
            default ICECLOCK_PANEL_HEIGHT_64

            config ICECLOCK_PANEL_HEIGHT_32
                bool "32 pixels (1/16 scan)"

            config ICECLOCK_PANEL_HEIGHT_64
                bool "64 pixels (1/32 scan)"
        endchoice

        config ICECLOCK_PANEL_HEIGHT_PIXELS
            int
            default 32 if ICECLOCK_PANEL_HEIGHT_32
            default 64 if ICECLOCK_PANEL_HEIGHT_64

        config ICECLOCK_COLOR_DEPTH
            int "PWM color depth (bits per channel)"
            range 1 5
            default 4

        config ICECLOCK_PWM_BASE_US
            int "PWM least-significant plane time (microseconds)"
            range 1 30
            default 6

        config ICECLOCK_DAY_BRIGHTNESS
            int "Day brightness percent"
            range 1 100
            default 70

        config ICECLOCK_NIGHT_BRIGHTNESS
            int "Night brightness percent"
            range 1 100
            default 12

        config ICECLOCK_NIGHT_START_HOUR
            int "Night mode start hour"
            range 0 23
            default 22

        config ICECLOCK_NIGHT_END_HOUR
            int "Night mode end hour"
            range 0 23
            default 7

        config ICECLOCK_PIN_R1
            int "HUB75 R1 GPIO"
            range 0 48
            default 1
        config ICECLOCK_PIN_G1
            int "HUB75 G1 GPIO"
            range 0 48
            default 2
        config ICECLOCK_PIN_B1
            int "HUB75 B1 GPIO"
            range 0 48
            default 3
        config ICECLOCK_PIN_R2
            int "HUB75 R2 GPIO"
            range 0 48
            default 4
        config ICECLOCK_PIN_G2
            int "HUB75 G2 GPIO"
            range 0 48
            default 5
        config ICECLOCK_PIN_B2
            int "HUB75 B2 GPIO"
            range 0 48
            default 6
        config ICECLOCK_PIN_A
            int "HUB75 A GPIO"
            range 0 48
            default 7
        config ICECLOCK_PIN_B
            int "HUB75 B GPIO"
            range 0 48
            default 8
        config ICECLOCK_PIN_C
            int "HUB75 C GPIO"
            range 0 48
            default 9
        config ICECLOCK_PIN_D
            int "HUB75 D GPIO"
            range 0 48
            default 10
        config ICECLOCK_PIN_E
            int "HUB75 E GPIO (used by 64-pixel panels)"
            range 0 48
            default 11
        config ICECLOCK_PIN_LAT
            int "HUB75 LAT GPIO"
            range 0 48
            default 12
        config ICECLOCK_PIN_OE
            int "HUB75 OE GPIO"
            range 0 48
            default 13
        config ICECLOCK_PIN_CLK
            int "HUB75 CLK GPIO"
            range 0 48
            default 14
    endmenu

    menu "RTC and alerts"
        config ICECLOCK_DS3231_ENABLE
            bool "Use DS3231 as the offline RTC"
            default y

        config ICECLOCK_I2C_SDA_GPIO
            int "DS3231 SDA GPIO"
            depends on ICECLOCK_DS3231_ENABLE
            range 0 48
            default 15

        config ICECLOCK_I2C_SCL_GPIO
            int "DS3231 SCL GPIO"
            depends on ICECLOCK_DS3231_ENABLE
            range 0 48
            default 16

        config ICECLOCK_CHIME_ENABLE
            bool "Enable hourly active-buzzer chime"
            default n

        config ICECLOCK_CHIME_GPIO
            int "Active buzzer GPIO"
            depends on ICECLOCK_CHIME_ENABLE
            range 0 48
            default 17
    endmenu

endmenu
```

## openpal/firmware/main/Kconfig.projbuild
```kconfig
menu "OpenPal Configuration"

    config OPENPAL_WIFI_SSID
        string "WiFi SSID"
        default "your-ssid"

    config OPENPAL_WIFI_PASSWORD
        string "WiFi Password"
        default "your-password"

    config OPENPAL_SERVER_URI
        string "OpenPal server URI"
        default "ws://192.168.1.100:8080/ws"
        help
            WebSocket endpoint of the OpenPal Python server.

    config OPENPAL_PTT_GPIO
        int "Push-to-talk button GPIO"
        default 4
        help
            GPIO number of the PTT button (active low, internal pull-up).
            GPIO0 is intentionally avoided because it is a boot strap pin.

    config OPENPAL_LED_GPIO
        int "Status LED GPIO"
        default 2
        help
            Onboard status LED GPIO.

    config OPENPAL_INPUT_SAMPLE_RATE
        int "Microphone sample rate (Hz)"
        default 16000

    config OPENPAL_OUTPUT_SAMPLE_RATE
        int "Initial speaker sample rate (Hz)"
        default 24000
        help
            The server announces the real rate for every reply and the
            firmware reconfigures the TX clock when needed.

    config OPENPAL_MAX_UTTERANCE_SECONDS
        int "Maximum push-to-talk duration (seconds)"
        range 3 60
        default 15

    menu "INMP441 microphone (I2S1 RX)"
        config OPENPAL_MIC_BCLK_GPIO
            int "BCLK GPIO"
            default 14

        config OPENPAL_MIC_WS_GPIO
            int "WS/LRCL GPIO"
            default 15

        config OPENPAL_MIC_DIN_GPIO
            int "SD/DIN GPIO"
            default 32

        choice OPENPAL_MIC_CHANNEL
            prompt "INMP441 L/R channel"
            default OPENPAL_MIC_CHANNEL_LEFT

            config OPENPAL_MIC_CHANNEL_LEFT
                bool "Left (L/R pin tied to GND)"

            config OPENPAL_MIC_CHANNEL_RIGHT
                bool "Right (L/R pin tied to 3V3)"
        endchoice

        config OPENPAL_MIC_SHIFT
            int "32-bit microphone to PCM16 right shift"
            range 8 20
            default 14
            help
                INMP441 carries 24-bit samples in 32-bit I2S slots. Increase
                this value if input clips; decrease it if input is too quiet.
    endmenu

    menu "MAX98357A speaker (I2S0 TX)"
        config OPENPAL_SPK_BCLK_GPIO
            int "BCLK GPIO"
            default 26

        config OPENPAL_SPK_WS_GPIO
            int "LRC/WS GPIO"
            default 25

        config OPENPAL_SPK_DOUT_GPIO
            int "DIN/DOUT GPIO"
            default 22

        config OPENPAL_PLAYBACK_BUFFER_BYTES
            int "Playback stream buffer (bytes)"
            range 8192 65536
            default 32768
    endmenu

endmenu
```

## openpal/firmware/sdkconfig.defaults
```kconfig
# Target (overridden by idf.py set-target)
CONFIG_IDF_TARGET="esp32"

# WiFi
CONFIG_ESP_WIFI_ENABLE_WIFI_RX_STATS=y

# HTTP / WS client
CONFIG_ESP_TLS_INSECURE=y
CONFIG_ESP_TLS_SKIP_SERVER_CERT_VERIFY=y

# mDNS
CONFIG_MDNS_MAX_SERVICES=5

# FreeRTOS
CONFIG_FREERTOS_HZ=1000

# Log
CONFIG_LOG_DEFAULT_LEVEL_INFO=y

# Flash
CONFIG_ESPTOOLPY_FLASHSIZE_4MB=y
CONFIG_PARTITION_TABLE_CUSTOM=y
CONFIG_PARTITION_TABLE_CUSTOM_FILENAME="partitions.csv"

# Compiler
CONFIG_COMPILER_OPTIMIZATION_PERF=y

# LWIP
CONFIG_LWIP_MAX_SOCKETS=12
```
