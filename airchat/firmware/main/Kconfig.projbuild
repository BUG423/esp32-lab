## airchat/firmware/main/Kconfig.projbuild
```kconfig
menu "AirChat Configuration"

    config AIRCHAT_NICKNAME
        string "Node nickname"
        default "anon"
        help
            Shown next to every message you send. Max 32 characters
            (longer values are truncated at runtime).

    config AIRCHAT_CHANNEL
        int "WiFi / ESP-NOW channel"
        range 1 13
        default 6
        help
            Radio channel used for both SoftAP and ESP-NOW broadcast.
            Every node in the same group must use the same channel.

    config AIRCHAT_LED_GPIO
        int "Activity LED GPIO"
        default 2
        help
            GPIO driving the activity LED. Flashes on every TX and RX.
            On most ESP32 dev boards GPIO2 is the onboard blue LED.

    config AIRCHAT_AP_PASSWORD
        string "SoftAP password (empty = open)"
        default ""
        help
            Password for the airchat-XXXX access point. Leave empty for an
            open network (easiest for field use). If set, it must be at
            least 8 characters (WPA2).

endmenu
```

## airchat/firmware/sdkconfig.defaults
```kconfig
# Target (overridden by idf.py set-target)
CONFIG_IDF_TARGET="esp32"

# HTTP + WebSocket
CONFIG_HTTPD_WS_SUPPORT=y

CONFIG_FREERTOS_HZ=1000
CONFIG_LOG_DEFAULT_LEVEL_INFO=y

CONFIG_ESPTOOLPY_FLASHSIZE_4MB=y
CONFIG_PARTITION_TABLE_CUSTOM=y
CONFIG_PARTITION_TABLE_CUSTOM_FILENAME="partitions.csv"

CONFIG_COMPILER_OPTIMIZATION_PERF=y

CONFIG_ESP_WIFI_ENABLE_WIFI_RX_STATS=y
```

## bassline/firmware/main/Kconfig.projbuild
```kconfig
menu "Bassline Configuration"

    choice BASSLINE_MIC_TYPE
        prompt "Microphone type"
        default BASSLINE_MIC_I2S
        help
            Select how the ESP32 captures audio.

        config BASSLINE_MIC_I2S
            bool "I2S digital microphone (INMP441 / ICS-43434)"

        config BASSLINE_MIC_ADC
            bool "ADC analog microphone (electret + amp)"
    endchoice

    config BASSLINE_I2S_BCLK_GPIO
        int "I2S BCLK GPIO"
        depends on BASSLINE_MIC_I2S
        default 26
        range 0 33
        help
            Bit-clock pin for the I2S microphone.

    config BASSLINE_I2S_WS_GPIO
        int "I2S WS (LRCLK) GPIO"
        depends on BASSLINE_MIC_I2S
        default 25
        range 0 33
        help
            Word-select (left/right clock) pin for the I2S microphone.

    config BASSLINE_I2S_DIN_GPIO
        int "I2S DATA IN GPIO"
        depends on BASSLINE_MIC_I2S
        default 33
        range 0 39
        help
            Serial-data output pin of the microphone (ESP32 input).

    config BASSLINE_ADC_GPIO
        int "ADC microphone GPIO"
        depends on BASSLINE_MIC_ADC
        default 36
        range 0 39
        help
            ADC1-capable GPIO connected to the analog mic output
            (GPIO 32-39 on classic ESP32).

    config BASSLINE_SAMPLE_RATE
        int "Audio sample rate (Hz)"
        default 16000
        range 8000 48000
        help
            Capture rate. 16000 Hz is plenty for music visualisation
            and keeps the FFT cheap.

    config BASSLINE_FFT_SIZE
        int "FFT window size (power of two)"
        default 256
        range 128 512
        help
            Number of samples per FFT frame. 256 or 512 recommended.

    config BASSLINE_LOG_BINS
        int "Number of log-spaced frequency bins"
        default 48
        range 32 64
        help
            How many bars the spectrum is folded into (32-64).

    config BASSLINE_LED_GPIO
        int "WS2812 LED data GPIO"
        default 5
        range 0 33
        help
            GPIO driving the DIN of the NeoPixel / WS2812 strip.

    config BASSLINE_LED_COUNT
        int "Number of LEDs on the strip"
        default 60
        range 1 300
        help
            Physical LED count.

    config BASSLINE_WIFI_SSID
        string "WiFi SSID (STA, optional)"
        default ""
        help
            Leave empty to run SoftAP-only. When set, the ESP32 also
            joins this network so you can open the dashboard on your LAN.

    config BASSLINE_WIFI_PASS
        string "WiFi password (STA, optional)"
        default ""
        help
            Password for the STA network above.

endmenu
```

## bassline/firmware/sdkconfig.defaults
```kconfig
# Bassline defaults — ESP32 audio spectrum visualiser

CONFIG_IDF_TARGET="esp32"

# Flash / partitions
CONFIG_ESPTOOLPY_FLASHSIZE_4MB=y
CONFIG_PARTITION_TABLE_CUSTOM=y
CONFIG_PARTITION_TABLE_CUSTOM_FILENAME="partitions.csv"

# Stack sizes
CONFIG_ESP_MAIN_TASK_STACK_SIZE=8192
CONFIG_ESP_SYSTEM_EVENT_TASK_STACK_SIZE=4096

# HTTP server + WebSocket
CONFIG_HTTPD_WS_SUPPORT=y
CONFIG_HTTPD_MAX_REQ_HDR_LEN=1024
CONFIG_HTTPD_MAX_URI_LEN=512

# WiFi / LWIP
CONFIG_ESP_WIFI_STATIC_RX_BUFFER_NUM=8
CONFIG_ESP_WIFI_DYNAMIC_RX_BUFFER_NUM=24
CONFIG_ESP_WIFI_TX_BUFFER_TYPE=1
CONFIG_ESP_WIFI_DYNAMIC_TX_BUFFER_NUM=32
CONFIG_LWIP_MAX_SOCKETS=10
CONFIG_LWIP_SO_RCVBUF=y

# FreeRTOS / timing
CONFIG_FREERTOS_HZ=1000
CONFIG_ESP_TASK_WDT_TIMEOUT_S=30

# Log
CONFIG_LOG_DEFAULT_LEVEL_INFO=y

# Compiler
CONFIG_COMPILER_OPTIMIZATION_PERF=y
```

## bytepet/firmware/main/Kconfig.projbuild
```kconfig
menu "bytepet Configuration"

    config BYTEPET_WIFI_SSID
        string "WiFi SSID"
        default ""
        help
            SSID of the WiFi network to join. Leave empty to start
            a soft-AP named "bytepet-setup" instead.

    config BYTEPET_WIFI_PASS
        string "WiFi password"
        default ""
        help
            Password for the WiFi network. Leave empty for open networks.

    config BYTEPET_BUTTON_GPIO
        int "Button GPIO number"
        range 0 39
        default 0
        help
            GPIO connected to the physical button (active-low, internal pull-up).

    config BYTEPET_TICK_PERIOD_MS
        int "Pet tick period (ms)"
        range 100 60000
        default 1000
        help
            How often the pet tick task wakes up. One virtual minute
            is always 60000 ms of wall time regardless of this value.

endmenu
```

## bytepet/firmware/sdkconfig.defaults
```kconfig
# bytepet sdkconfig defaults
CONFIG_IDF_TARGET="esp32"
CONFIG_ESP_MAIN_TASK_STACK_SIZE=4096
CONFIG_FREERTOS_HZ=1000

# NVS
CONFIG_NVS_ENCRYPTION=n

# WiFi
CONFIG_ESP_WIFI_STATIC_RX_BUFFER_NUM=8
CONFIG_ESP_WIFI_DYNAMIC_RX_BUFFER_NUM=24

# HTTPD + WebSocket
CONFIG_HTTPD_WS_SUPPORT=y
CONFIG_HTTPD_MAX_REQ_HDR_LEN=1024
CONFIG_HTTPD_MAX_URI_LEN=512

# Console / logging
CONFIG_LOG_DEFAULT_LEVEL_INFO=y
CONFIG_ESP_CONSOLE_UART_DEFAULT=y

# Partition table
CONFIG_PARTITION_TABLE_CUSTOM=y
CONFIG_PARTITION_TABLE_CUSTOM_FILENAME="partitions.csv"
```

## deckpad/firmware/main/Kconfig.projbuild
```kconfig
menu "DeckPad Configuration"

    config DECKPAD_DEVICE_NAME
        string "BLE device name"
        default "DeckPad"

    config DECKPAD_WIFI_SSID
        string "WiFi SSID (for web config)"
        default "your-ssid"

    config DECKPAD_WIFI_PASSWORD
        string "WiFi Password"
        default "your-password"

    config DECKPAD_NUM_BUTTONS
        int "Number of buttons"
        range 1 8
        default 4

    config DECKPAD_BTN0_GPIO
        int "Button 0 GPIO"
        default 0

    config DECKPAD_BTN1_GPIO
        int "Button 1 GPIO"
        default 4

    config DECKPAD_BTN2_GPIO
        int "Button 2 GPIO"
        default 16

    config DECKPAD_BTN3_GPIO
        int "Button 3 GPIO"
        default 17

    config DECKPAD_LED_GPIO
        int "Status LED GPIO"
        default 2

endmenu
```

## deckpad/firmware/sdkconfig.defaults
```kconfig
CONFIG_IDF_TARGET="esp32"

# Bluetooth HID device
CONFIG_BT_ENABLED=y
CONFIG_BT_BLUEDROID_ENABLED=y
CONFIG_BT_BLE_ENABLED=y
CONFIG_BT_HID_DEVICE_ENABLED=y
CONFIG_BT_BTU_TASK_STACK_SIZE=4096

# HTTP + WS
CONFIG_HTTPD_WS_SUPPORT=y

CONFIG_FREERTOS_HZ=1000
CONFIG_LOG_DEFAULT_LEVEL_INFO=y
CONFIG_ESPTOOLPY_FLASHSIZE_4MB=y
CONFIG_PARTITION_TABLE_CUSTOM=y
CONFIG_PARTITION_TABLE_CUSTOM_FILENAME="partitions.csv"
CONFIG_COMPILER_OPTIMIZATION_PERF=y
```

## esp-csi-radar/firmware/main/Kconfig.projbuild
```kconfig
menu "CSI Radar Configuration"

    config CSI_RADAR_WIFI_SSID
        string "WiFi SSID"
        default "your-ssid"
        help
            SSID of the WiFi network to join (STA mode).

    config CSI_RADAR_WIFI_PASSWORD
        string "WiFi Password"
        default "your-password"
        help
            Password of the WiFi network.

    config CSI_RADAR_HOSTNAME
        string "mDNS hostname"
        default "csi-radar"
        help
            Device will be reachable at http://<hostname>.local

    config CSI_RADAR_PRESENCE_THRESHOLD_X100
        int "Presence energy threshold x100"
        range 100 1000
        default 250
        help
            Motion energy above baseline * (value/100) triggers presence.
            250 means threshold = 2.5.

    config CSI_RADAR_BASELINE_ALPHA_X1000
        int "Baseline EMA alpha x1000"
        range 1 200
        default 20
        help
            Smoothing factor for adaptive empty-room baseline.
            20 means alpha = 0.02.

    config CSI_RADAR_MQTT_ENABLE
        bool "Enable Home Assistant MQTT discovery"
        default n
        help
            Publish presence / motion / breathing sensors to an MQTT broker
            and auto-register them in Home Assistant via MQTT discovery.

    config CSI_RADAR_MQTT_URI
        string "MQTT broker URI"
        depends on CSI_RADAR_MQTT_ENABLE
        default "mqtt://192.168.1.100:1883"
        help
            e.g. mqtt://homeassistant.local:1883

    config CSI_RADAR_MQTT_USERNAME
        string "MQTT username (optional)"
        depends on CSI_RADAR_MQTT_ENABLE
        default ""

    config CSI_RADAR_MQTT_PASSWORD
        string "MQTT password (optional)"
        depends on CSI_RADAR_MQTT_ENABLE
        default ""

    config CSI_RADAR_MQTT_TOPIC_PREFIX
        string "MQTT topic prefix"
        depends on CSI_RADAR_MQTT_ENABLE
        default "csi_radar"
        help
            State at <prefix>/state, availability at <prefix>/status.

endmenu
```

## esp-csi-radar/firmware/sdkconfig.defaults
```kconfig
# Target
CONFIG_IDF_TARGET="esp32"

# WiFi
CONFIG_ESP_WIFI_ENABLE_WIFI_RX_STATS=y
CONFIG_ESP_WIFI_ENABLE_WIFI_RX_MU_STATS=y

# HTTP Server + WebSocket
CONFIG_HTTPD_WS_SUPPORT=y
CONFIG_HTTPD_MAX_REQ_HDR_LEN=1024
CONFIG_HTTPD_MAX_URI_LEN=512

# mDNS
CONFIG_MDNS_MAX_SERVICES=10

# FreeRTOS
CONFIG_FREERTOS_HZ=1000

# Log
CONFIG_LOG_DEFAULT_LEVEL_INFO=y

# Partition / flash
CONFIG_ESPTOOLPY_FLASHSIZE_4MB=y
CONFIG_PARTITION_TABLE_CUSTOM=y
CONFIG_PARTITION_TABLE_CUSTOM_FILENAME="partitions.csv"

# Compiler
CONFIG_COMPILER_OPTIMIZATION_PERF=y
```

## glowlink/firmware/main/Kconfig.projbuild
```kconfig
menu "GlowLink Configuration"

    config GLOWLINK_WIFI_SSID
        string "WiFi SSID"
        default "your-ssid"

    config GLOWLINK_WIFI_PASSWORD
        string "WiFi Password"
        default "your-password"

    config GLOWLINK_HOSTNAME
        string "mDNS hostname"
        default "glowlink"

    config GLOWLINK_TX_GPIO
        int "LED TX GPIO (drive)"
        default 4
        help
            GPIO that drives the LED through a 220 ohm resistor.

    config GLOWLINK_RX_GPIO
        int "LED RX ADC GPIO (sense)"
        default 34
        help
            ADC1 channel pin connected to the LED anode (or a second LED).
            e.g. GPIO34 = ADC1_CH6 on ESP32.

    config GLOWLINK_BAUD
        int "Optical baud rate (bps)"
        range 50 2000
        default 250
        help
            Slower = more reliable. 250 bps is a good demo value.

    config GLOWLINK_IS_SENDER
        bool "This node is the default sender (beacon)"
        default y
        help
            Sender beacons periodically; receiver listens. Can be toggled
            from the web panel at runtime.

endmenu
```

## glowlink/firmware/sdkconfig.defaults
```kconfig
# Target (overridden by idf.py set-target)
CONFIG_IDF_TARGET="esp32"

CONFIG_ESP_WIFI_ENABLE_WIFI_RX_STATS=y

# HTTP + WS
CONFIG_HTTPD_WS_SUPPORT=y

CONFIG_FREERTOS_HZ=1000
CONFIG_LOG_DEFAULT_LEVEL_INFO=y

CONFIG_ESPTOOLPY_FLASHSIZE_4MB=y
CONFIG_PARTITION_TABLE_CUSTOM=y
CONFIG_PARTITION_TABLE_CUSTOM_FILENAME="partitions.csv"

CONFIG_COMPILER_OPTIMIZATION_PERF=y

# ADC
CONFIG_ADC_CAL_EFUSE_TP_ENABLE=y
CONFIG_ADC_CAL_EFUSE_VREF_ENABLE=y
```
